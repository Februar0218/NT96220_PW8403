DSC_FW  0x0
{
    ; Special RO is the exception table, version info and clock API that will be
    ; lock in cache
    SPECIAL_RO +0x0
    {
        Startup.o (+RO, +FIRST)
        VersionInfo.o (+RO)
    }

    SPECIAL_CLOCK_RW +0x0
    {
        Clock.o (+RW)
    }

    SPECIAL_CLOCK_RO +0x0
    {
        ClockAPI.o (+RO, +FIRST)
        Clock.o (+RO-CODE)
        Clock.o (+RO-DATA, +LAST)
    }

    ; Part one is the kernel and driver rquired for lens control
    PART_ONE_RO +0x0
    {
; The object codes that don't have any RO section are marked to prevent linker warning
; If you modify any code below, make sure to check these configuration again.
; Standard C library
        *.l (+RO)
; Startup code
        DATKER.o (+RO)
        InitCLibMMU.o (+RO)
        KerInit.o (+RO)
        Loader.o (+RO)
        CopyRest.o (+RO)
        SysCfg.o (+RO)
        Main.o (+RO)
        OSCommon.o (+RO)
        StartKer.o (+RO)
        SystemInit.o (+RO)
        SystemTask.o (+RO)
        GPIOMapping.o (+RO)
; Kernel
        IntHnder.o (+RO)
        Kcenque.o (+RO)
;        KCHGPTY.o (+RO)
        KCHK_FLG.o (+RO)
        KCLR_FLG.o (+RO)
        KCSUSPD.o (+RO)
        Kdef_int.o (+RO)
        Kdis_int.o (+RO)
        Kena_int.o (+RO)
        ker.o (+RO)
        KerVerInfo.o (+RO)
        KEXT_TSK.o (+RO)
;        KGET_BLFSIZ.o (+RO)
;        KGET_TID.o (+RO)
        KICR_FLG.o (+RO)
        KICR_MBX.o (+RO)
        KICR_MPF.o (+RO)
        KICR_SEM.o (+RO)
        KICR_TSK.o (+RO)
        KINI_FLG.o (+RO)
        KINI_MBX.o (+RO)
        KINI_MPF.o (+RO)
        KINI_SEM.o (+RO)
        KINI_TCB.o (+RO)
        KREL_BLF.o (+RO)
        KRSM_TSK.o (+RO)
        KSET_FLG.o (+RO)
        KSIG_SEM.o (+RO)
;        KSND_MSG.o (+RO)
        KSRESUM.o (+RO)
        KSTA_TSK.o (+RO)
        KSUS_TSK.o (+RO)
;        KTCV_MSG.o (+RO)
        KTER_TSK.o (+RO)
        KTGT_BLF.o (+RO)
;        KTSERVC.o (+RO)
        KTWI_FLG.o (+RO)
        KTWI_SEM.o (+RO)
        KLOC_CPU.o (+RO)
        KUNL_CPU.o (+RO)
        Scheduler.o (+RO)
; Driver
        DrvCommon.o (+RO)
        top.o (+RO)
        pad.o (+RO)
        pll.o (+RO)
        Interrupt.o (+RO)
        dma.o (+RO)
        timer.o (+RO)
        PrimaryAPI.o (+RO)
        PrimaryTsk.o (+RO)
        RamDisk.o (+RO)
        Cache.o (+RO)
        GPIO.o (+RO)
        SIF.o (+RO)
        ide.o (+RO)
        ide_lib.o (+RO)
        ide_video.o (+RO)
        ide_tv.o (+RO)
        Uart.o (+RO)
        usb.o (+RO)
        jpeg.o (+RO)
        jpeg_int.o (+RO)
        LensCtrlTsk.o (+RO)
        LensAPI.o (+RO)
        LensDrv_ST8002.o (+RO)
        LensDrv_ST8003.o (+RO)
        LensDrv_ST8005.o (+RO)
        LensDrv_FF.o (+RO)
        LensDrv_DUMMY.o (+RO)
        LensMotor_MD152.o (+RO)
        LensMotor_MSHONLY.o (+RO)
        LensMotor_WT7026.o (+RO)
        LensMotor_ST1151.o (+RO)
        LensMotor_PSEUDO.o (+RO)
        LensMotor_DUMMY.o (+RO)
        Perf.o (+RO)
        RTC.o (+RO)
        spi.o (+RO)
        PStore.o (+RO)
        NOR_PS.o (+RO)
        NAND.o (+RO)
        NAND_PS.o (+RO)
        FileSysTskAPI.o (+RO)
; Task
        INITSK.o (+RO)
        LensCtrlTsk.o (+RO)
; Debug
        Debug.o (+RO)
; Utility
        Delay.o (+RO)
        lz.o (+RO)
        JpgEnc.o (+RO)
        JpgDec.o (+RO)
        JpegHeader.o (+RO)
        JpgParseHeader.o (+RO)
        screen_160x120.o (+RO)
        GiantPlusGPG48238QS5.o (+RO)
        ToppolyTD024THEB2.o (+RO)
        ToppolyTD20.o (+RO)
        AUCN01.o (+RO)
        TXDT180A_18V6.o (+RO)
        TXDT270M.o (+RO)
        TXDT270CDR_2V7.o (+RO)
        TXDT270C.o (+RO)
        ALT030HSLN_J2.o (+RO)
        RZWT27P02.o (+RO)
        PS20P00.o (+RO)
        BG_Images.o (+RO)
        BG_Opening.o (+RO)
        GlobalVar.o (+RO)
        UserPStore.o (+RO)
        PWM.o (+RO)
        VoltageDet.o (+RO)
        KeyScanPWR.o (+RO)
        ADC.o (+RO)
        KeyScanLED.o (+RO)
        SystemClock.o (+RO)
        IME.o (+RO)
        FWRotate.o (+RO)
        disp_rotate.o (+RO) 
        Grph.o (+RO)
        Gesture.o (+RO)
        spiflash.o (+RO)
        UIConfig.o (+RO)
        Interface.o (+RO)
        UISystemStatusSettings.o(+RO)
        UISystemObj.o (+RO)
        UICtrlMenuLib.o  (+RO)
        UICtrlListLib.o  (+RO)
        UIFrameworkAPI.o (+RO)
        UIMenuWndPhotoSize.o(+RO)
        UIMenuWndMovieSize.o(+RO)
        UIMenuWndLanguage.o(+RO)
        mi.o (+RO)
        ILI9341.o (+RO)
        ALT020DSLN_J2.o (+RO)
        TXDT200LER_31V2.o(+RO)
        HX8238.o(+RO)
        disp1.o (+RO)
        disp2.o (+RO)
        display.o (+RO)
        dispdev_hdmi.o (+RO)
        dispdev_panlcomn.o (+RO)
        dispdev_IF8bits.o (+RO)
        dispdev_IF8bits_int.o (+RO)
        dispdev_IFmi.o (+RO)
        dispdev_IFmi_int.o (+RO)
        dispdev_tv.o (+RO)
        CalLens.o (+RO)
    }

    PART_ONE_RW +0x0
    {
; The object codes that don't have any RW section are marked to prevent linker warning.
; If you modify any code below, make sure to check these configuration again.
; Standard C library
;        *.l (+RW)
; Startup code
        DATKER.o (+RW)
;        InitCLibMMU.o (+RW)
        KerInit.o (+RW)
;        Loader.o (+RW)
;        CopyRest.o (+RW)
        SysCfg.o (+RW)
;        Main.o (+RW)
        OSCommon.o (+RW)
;        StartKer.o (+RW)
        SystemInit.o (+RW)
;        SystemTask.o (+RW)
        GPIOMapping.o (+RW)
; Kernel
;        IntHnder.o (+RW)
;        Kcenque.o (+RW)
;        KCHGPTY.o (+RW)
;        KCHK_FLG.o (+RW)
;        KCLR_FLG.o (+RW)
;        KCSUSPD.o (+RW)
;        Kdef_int.o (+RW)
;        Kdis_int.o (+RW)
;        Kena_int.o (+RW)
;        ker.o (+RW)
        KerVerInfo.o (+RW)
;        KEXT_TSK.o (+RW)
;        KGET_BLFSIZ.o (+RW)
;        KGET_TID.o (+RW)
;        KICR_FLG.o (+RW)
;        KICR_MBX.o (+RW)
;        KICR_MPF.o (+RW)
;        KICR_SEM.o (+RW)
;        KICR_TSK.o (+RW)
;        KINI_FLG.o (+RW)
;        KINI_MBX.o (+RW)
;        KINI_MPF.o (+RW)
;        KINI_SEM.o (+RW)
;        KINI_TCB.o (+RW)
;        KREL_BLF.o (+RW)
;        KRSM_TSK.o (+RW)
;        KSET_FLG.o (+RW)
;        KSIG_SEM.o (+RW)
;        KSND_MSG.o (+RW)
;        KSRESUM.o (+RW)
;        KSTA_TSK.o (+RW)
;        KSUS_TSK.o (+RW)
;        KTCV_MSG.o (+RW)
;        KTER_TSK.o (+RW)
;        KTGT_BLF.o (+RW)
;        KTSERVC.o (+RW)
;        KTWI_FLG.o (+RW)
;        KTWI_SEM.o (+RW)
;        Scheduler.o (+RW)
; Driver
        DrvCommon.o (+RW)
        top.o (+RW)
        pad.o (+RW)
        pll.o (+RW)
        Interrupt.o (+RW)
        dma.o (+RW)
        timer.o (+RW)
        Cache.o (+RW)
        GPIO.o (+RW)
        SIF.o (+RW)
        Uart.o (+RW)
        usb.o (+RW)
        LensCtrlTsk.o (+RW)
        LensAPI.o (+RW)
        LensDrv_ST8002.o (+RW)
        LensDrv_ST8003.o (+RW)
        LensDrv_ST8005.o (+RW)
        LensDrv_FF.o (+RW)
        LensDrv_DUMMY.o (+RW)
        LensMotor_MD152.o (+RW)
        LensMotor_MSHONLY.o (+RW)
        LensMotor_WT7026.o (+RW)
        LensMotor_ST1151.o (+RW)
        LensMotor_PSEUDO.o (+RW)
        LensMotor_DUMMY.o (+RW)
        Perf.o (+RW)
        RTC.o (+RW)
        PrimaryAPI.o (+RW)
		PrimaryTsk.o	(+RW)
        RamDisk.o (+RW)
        spi.o (+RW)
        NOR_PS.o (+RW)
        NAND.o (+RW)
        NAND_PS.o (+RW)
        FileSysTskAPI.o (+RW)
        FileSysTskDCFUtil.o (+RW)
        fs_file_lib.o (+RW)
; Task
;        INITSK.o (+RW)
;        LensCtrlTsk.o (+RW)
; Debug
        Debug.o (+RW)
; Utility
;        Delay.o (+RW)
        lz.o (+RW)
        JpgEnc.o (+RW)
        JpgDec.o (+RW)
        JpegHeader.o (+RW)
        JpgParseHeader.o (+RW)
        screen_160x120.o (+RW)
        GiantPlusGPG48238QS5.o (+RW)
        ToppolyTD024THEB2.o (+RW)
        ToppolyTD20.o (+RW)
        AUCN01.o (+RW)
        TXDT180A_18V6.o (+RW)
        TXDT270M.o (+RW)
        TXDT270CDR_2V7 (+RW)
        TXDT270C (+RW)
        ALT030HSLN_J2.o (+RW)
        RZWT27P02.o (+RW)
        PS20P00.o (+RW)
        BG_Images.o (+RW)
        BG_Opening.o (+RW)
        GlobalVar.o (+RW)
        PWM.o (+RW)
        VoltageDet.o (+RW)
        KeyScanPWR.o (+RW)
        ADC.o (+RW)
        KeyScanLED.o (+RW)
        SystemClock.o (+RW)
        IME.o (+RW)
        FWRotate.o (+RW)
        disp_rotate.o (+RW)
        Grph.o (+RW)
        spiflash.o (+RW)
        UIConfig.o (+RW)
        Interface.o (+RW)
        UISystemStatusSettings.o(+RW)
        UISystemObj.o (+RW)
        UICtrlMenuLib.o  (+RW)
        UICtrlListLib.o  (+RW)
        UIFrameworkAPI.o (+RW)
        UIMenuWndPhotoSize.o(+RW)
        UIMenuWndLanguage.o(+RW)
        ILI9341.o (+RW)
        ALT020DSLN_J2.o (+RW)
        TXDT200LER_31V2.o(+RW)
        HX8238.o(+RW)
        mi.o (+RW)
        disp1.o (+RW)
        disp2.o (+RW)
        display.o (+RW)
        dispdev_hdmi.o (+RW)
        dispdev_IF8bits.o (+RW)
        dispdev_IF8bits_int.o (+RW)
        dispdev_IFmi.o (+RW)
        dispdev_IFmi_int.o (+RW)
        dispdev_tv.o (+RW)
        MenuPhoto.o (+RW)
    }

    ; Part two is the logo / sound and AP used when power on
    PART_TWO_RO +0x0
    {
;        JpgEnc.o (+RO)
;        JpgDec.o (+RO)
;        JPEG210.o (+RO)
;        JpegHeader.o (+RO)
;        JpgParseHeader.o (+RO)
;        AUAN04.o (+RO)
;        IDE210.o (+RO)
;        IDELib210.o (+RO)
;        DMA.o (+RO)
;        GlobalVar.o (+RO)
;        BG_Images.o (+RO)
;        ShowOSDFuncs.o (+RO)
;        Draw_Lib.o (+RO)
        CommandTsk.o (+RO)
        *(+RO)
    }

    PART_TWO_RW +0x0
    {
;        JpgEnc.o (+RW)
;        JpgDec.o (+RW)
;        JPEG210.o (+RW)
;        JpegHeader.o (+RW)
;        JpgParseHeader.o (+RW)
;        AUAN04.o (+RW)
;        IDE210.o (+RW)
;        IDELib210.o (+RW)
;        DMA.o (+RW)
;        GlobalVar.o (+RW)
;        BG_Images.o (+RW)
;        ShowOSDFuncs.o (+RW)
;        Draw_Lib.o (+RW)
        CommandTsk.o (+RW)
         *(+RW)
    }

    ;PART_THREE_RO +0x0
    ;{
    ;    *(+RO)
    ;}

    ;PART_THREE_RW +0x0
    ;{
    ;    *(+RW)
    ;}

    LOAD_RESET 0x00A00000
    {
        UpdateNandReset.o (*)
    }
}

LOAD_REGION2 +0x0
{
    GENERAL_ZI +0x0
    {
        *(+ZI)
    }
}